## abs/meta-comsa/conf/layer.conf
```bitbake
# We have a conf directory, add to BBPATH
BBPATH := "${LAYERDIR}:${BBPATH}"

# We have a package directory, add to BBFILES
BBFILES := "${BBFILES} ${LAYERDIR}/recipes-*/*/*.bb \
            ${LAYERDIR}/recipes-*/*/*.bbappend"

BBFILE_COLLECTIONS += "comsa"
BBFILE_PATTERN_comsa := "^${LAYERDIR}/"
BBFILE_PRIORITY_comsa = "6"

FILESEXTRAPATHS_prepend := "${LAYERDIR}/../downloads:"
```
